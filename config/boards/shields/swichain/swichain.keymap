#include <behaviors.dtsi>
#include <dt-bindings/zmk/keys.h>
#include <dt-bindings/zmk/bt.h>
#include <dt-bindings/zmk/outputs.h>
 
/ {
    macros {
        press_prev: press_prev {
            compatible = "zmk,behavior-macro";
            #binding-cells = <0>;
            wait-ms = <40>;
            tap-ms = <40>;
            bindings =
                <&macro_tap &kp C_PREV>;
        };
        press_pause: press_pause {
            compatible = "zmk,behavior-macro";
            #binding-cells = <0>;
            wait-ms = <40>;
            tap-ms = <40>;
            bindings =
                <&macro_tap &kp C_PAUSE>;
        };
        press_next: press_next {
            compatible = "zmk,behavior-macro";
            #binding-cells = <0>;
            wait-ms = <40>;
            tap-ms = <40>;
            bindings =
                <&macro_tap &kp C_NEXT>;
        };
        press_f23: press_f23 {
            compatible = "zmk,behavior-macro";
            #binding-cells = <0>;
            wait-ms = <40>;
            tap-ms = <40>;
            bindings =
                <&macro_tap &kp F23>;
        };
        steam: steam {
            compatible = "zmk,behavior-macro";
            #binding-cells = <0>;
            wait-ms = <40>;
            tap-ms = <40>;
            bindings =
                <&macro_press &kp LEFT_WIN>,
                <&macro_tap &kp NUMBER_5>;
                <&macro_release &kp LEFT_WIN>
        };
        spotify: spotify {
            compatible = "zmk,behavior-macro";
            #binding-cells = <0>;
            wait-ms = <40>;
            tap-ms = <40>;
            bindings =
                <&macro_press &kp LEFT_WIN>,
                <&macro_tap &kp NUMBER_6>;
                <&macro_release &kp LEFT_WIN>
        };
        discord: discord {
            compatible = "zmk,behavior-macro";
            #binding-cells = <0>;
            wait-ms = <40>;
            tap-ms = <40>;
            bindings =
                <&macro_press &kp LEFT_WIN>,
                <&macro_tap &kp NUMBER_8>;
                <&macro_release &kp LEFT_WIN>
        };
    };
    keymap {
        compatible = "zmk,keymap";
 
        default_layer {
            bindings = <
                &press_prev  &press_pause  %press_next  &press_f23  &steam  &spotify  &discord  &bt BT_CLR
            >;
            sensor-bindings = <&inc_dec_kp C_VOL_UP C_VOL_DN>;
        };
    };
};