## boards/shields/swichain/Kconfig.defconfig
```kconfig
if SHIELD_SWICHAIN

config ZMK_KEYBOARD_NAME
    default "SwiChain"

endif # SHIELD_SWICHAIN
```

## config/west.yml
```yaml
manifest:
  version: "0.13"
  defaults:
    remote: zmkfirmware
    revision: v0.3

  remotes:
    - name: zmkfirmware
      url-base: https://github.com/zmkfirmware

  projects:
    - name: zmk
      remote: zmkfirmware
      import: app/west.yml

  self:
    path: config
    import:
      - name: zmk-config
```
